## drivers/kernelsu/Kconfig
```kconfig
menu "KernelSU"

config KSU
	bool "KernelSU function support"
	depends on EXT4_FS
	default y
	help
	  Enable kernel-level root privileges on Android System using
	  built-in manual VFS, syscall, and input hooks.
	  Requires CONFIG_EXT4_FS for `ext4_unregister_sysfs`.

config KSU_DEBUG
	bool "KernelSU debug mode"
	depends on KSU
	default n
	help
	  Enable KernelSU debug mode.

config KSU_DISABLE_MANAGER
	bool "Disable KernelSU manager integration"
	depends on KSU
	default n
	help
	  Disable manager APK detection and manager-specific handling.
	  Root will be used in place of manager-only functionality.

config KSU_DISABLE_POLICY
	bool "Disable KernelSU policy profiles"
	depends on KSU
	default n
	help
	  Disable per-app root/non-root profile customization.
	  Escalation will always use the default full root profile, and
	  non-root handling will follow the global umount policy only.

endmenu
```

## google-modules/soc/gs/drivers/dma-buf/heaps/Kconfig
```kconfig
# SPDX-License-Identifier: GPL-2.0

menuconfig DMABUF_HEAPS_DEFERRED_FREE
	bool "DMA-BUF heaps deferred-free library"
	help
	  Choose this option to enable the DMA-BUF heaps deferred-free library.

menuconfig DMABUF_HEAPS_PAGE_POOL
	bool "DMA-BUF heaps page-pool library"
	help
	  Choose this option to enable the DMA-BUF heaps page-pool library.


source "$(KCONFIG_SOC_GS_PREFIX)drivers/dma-buf/heaps/samsung/Kconfig"
```
